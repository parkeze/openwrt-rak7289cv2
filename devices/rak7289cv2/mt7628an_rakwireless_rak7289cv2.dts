// SPDX-License-Identifier: GPL-2.0-or-later OR MIT

#include "mt7628an_rakwireless_rak636.dtsi"

/ {
	compatible = "rakwireless,rak7289cv2", "mediatek,mt7628an-soc";
	model = "RAKwireless RAK7289CV2";
};

/* GNSS receiver, NMEA at 9600 baud. */
&uart1 {
	status = "okay";
};
